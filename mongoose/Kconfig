## mongoose/Kconfig
```kconfig
menu "Mongoose"

config MG_ENABLE_FILESYSTEM
    bool "Enable Filesystem"
    default n
    help
        For enable the filesystem support.
		
config MG_ENABLE_TELNET
    bool "Enable Telnet"
    default n
    help
        For enable the telnet support.

		
endmenu
```
